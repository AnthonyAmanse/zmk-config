/*
 * Copyright (c) 2021 Anthony Amanse
 *
 * SPDX-License-Identifier: MIT
 */

#include "amalgamate.dtsi"

/{
	kscan0: kscan {
		compatible = "zmk,kscan-gpio-matrix";
		label = "KSCAN";

		diode-direction = "col2row";
		row-gpios
			= <&gpio0 10 (GPIO_ACTIVE_HIGH | GPIO_PULL_DOWN)>
			, <&gpio1  6 (GPIO_ACTIVE_HIGH | GPIO_PULL_DOWN)>
			, <&gpio0  9 (GPIO_ACTIVE_HIGH | GPIO_PULL_DOWN)>
			, <&gpio0 24 (GPIO_ACTIVE_HIGH | GPIO_PULL_DOWN)>
			, <&gpio0 13 (GPIO_ACTIVE_HIGH | GPIO_PULL_DOWN)>
			;

		col-gpios
			= <&gpio0 29 GPIO_ACTIVE_HIGH>
			, <&gpio0  2 GPIO_ACTIVE_HIGH>
			, <&gpio1 13 GPIO_ACTIVE_HIGH>
			, <&gpio0 28 GPIO_ACTIVE_HIGH>
			, <&gpio0  3 GPIO_ACTIVE_HIGH>
			, <&gpio1 11 GPIO_ACTIVE_HIGH>
			;
	};
};

&default_transform {
		col-offset = <6>;
	};

&right_encoder {
	status = "okay";
};