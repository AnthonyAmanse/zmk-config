## config/boards/arm/amalgamate/Kconfig.board
```kconfig
# Copyright (c) 2021 Anthony Amanse
# SPDX-License-Identifier: MIT

config BOARD_AMALGAMATE_LEFT
	bool "amalgamate_left"
	depends on SOC_NRF52840_QIAA

config BOARD_AMALGAMATE_RIGHT
	bool "amalgamate_right"
	depends on SOC_NRF52840_QIAA
```

## config/boards/arm/amalgamate/Kconfig.defconfig
```kconfig
# Copyright (c) 2020 Darryl deHaan
# SPDX-License-Identifier: MIT

if BOARD_AMALGAMATE_LEFT

	config ZMK_KEYBOARD_NAME
	default "Amalgam8"

endif # BOARD_AMALGAMATE_LEFT

if BOARD_AMALGAMATE_RIGHT

	config ZMK_KEYBOARD_NAME
	default "Amalgam8 Rt"

endif # BOARD_AMALGAMATE_RIGHT


if BOARD_AMALGAMATE_LEFT || BOARD_AMALGAMATE_RIGHT

config BOARD
	default "amalgamate"

config ZMK_SPLIT
	default y

config SPI
    bool
    default y

config BT_CTLR
	default BT

config ZMK_BLE
	default y

config ZMK_USB
	default y
	
config ZMK_BATTERY_VOLTAGE_DIVIDER
	default y

if USB

config USB_NRFX
	default y

config USB_DEVICE_STACK
	default y

endif # USB

config SPI
	default y

if ZMK_DISPLAY

config IL0323
	default y

endif # ZMK_DISPLAY

if LVGL

config LVGL_HOR_RES_MAX
	default 80

config LVGL_VER_RES_MAX
	default 128

config LVGL_VDB_SIZE
	default 32

config LVGL_DPI
	default 145

config LVGL_BITS_PER_PIXEL
	default 1

choice LVGL_COLOR_DEPTH
	default LVGL_COLOR_DEPTH_1
endchoice

endif # LVGL


config CUSTOM_WIDGET_BATTERY_STATUS
	bool
	default y

config CUSTOM_WIDGET_CHARGE_STATUS
	bool
	default y

endif # BOARD_AMALGAMATE_LEFT || BOARD_AMALGAMATE_RIGHT
```

## config/boards/arm/amalgamate/amalgamate_left_defconfig
```kconfig
# SPDX-License-Identifier: MIT

CONFIG_SOC_SERIES_NRF52X=y
CONFIG_SOC_NRF52840_QIAA=y
CONFIG_BOARD_AMALGAMATE_LEFT=y
CONFIG_ZMK_SPLIT=y
CONFIG_ZMK_SPLIT_BLE_ROLE_CENTRAL=y
# CONFIG_ZMK_SLEEP=y
CONFIG_ZMK_DISPLAY=y
CONFIG_SSD1306=n
CONFIG_ZMK_WIDGET_LAYER_STATUS=n

# custom status screen
CONFIG_ZMK_DISPLAY_STATUS_SCREEN_CUSTOM=y
CONFIG_ZMK_WIDGET_BATTERY_STATUS=n

# Enable MPU
CONFIG_ARM_MPU=y

# enable GPIO
CONFIG_GPIO=y

# Enable writing to flash
CONFIG_USE_DT_CODE_PARTITION=y
CONFIG_MPU_ALLOW_FLASH_WRITE=y
CONFIG_NVS=y
CONFIG_SETTINGS_NVS=y
CONFIG_FLASH=y
CONFIG_FLASH_PAGE_LAYOUT=y
CONFIG_FLASH_MAP=y

CONFIG_EC11=y
CONFIG_EC11_TRIGGER_GLOBAL_THREAD=y
# CONFIG_ZMK_USB_LOGGING=y
# CONFIG_ZMK_BLE_CLEAR_BONDS_ON_START=y
```

## config/boards/shields/untitled/Kconfig.shield
```kconfig
# Copyright (c) 2021 Anthony Amanse
# SPDX-License-Identifier: MIT

config SHIELD_UNTITLED_LEFT
	def_bool $(shields_list_contains,untitled_left)

config SHIELD_UNTITLED_RIGHT
	def_bool $(shields_list_contains,untitled_right)
```

## config/west.yml
```yaml
manifest:
  remotes:
    - name: zmkfirmware
      url-base: https://github.com/zmkfirmware
    - name: anthonyamanse
      url-base: https://github.com/AnthonyAmanse
  projects:
    - name: zmk
      remote: anthonyamanse
      revision: AnthonyAmanse-zmk-v2.4.0+inkdriver
      import: app/west.yml
  self:
    path: config
```
